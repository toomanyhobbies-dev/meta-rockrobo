// SPDX-License-Identifier: (GPL-2.0+ OR MIT)
/* Roborock S5 (S502-00). Board details and test-boot policy: sun8i-r16-roborock.dtsi */

/dts-v1/;
#include "sun8i-r16-roborock.dtsi"

#include <dt-bindings/pwm/pwm.h>

/ {
	model = "Roborock S5 (S502-00)";
	compatible = "roborock,s5", "allwinner,sun8i-r16", "allwinner,sun8i-a33";

	/* lidar motor, [lds_para] and [pwm0_para] in the stock FEX */
	lds-motor {
		compatible = "roborock,lds-motor";
		pinctrl-names = "default";
		pinctrl-0 = <&pwm0_pin>;
		pwms = <&pwm 0 50000 PWM_POLARITY_INVERTED>;
		mode-gpios = <&r_pio 0 5 GPIO_ACTIVE_HIGH>,	/* PL5 */
			     <&r_pio 0 4 GPIO_ACTIVE_HIGH>;	/* PL4 */
		interrupts-extended = <&r_pio 0 9 IRQ_TYPE_EDGE_FALLING>;	/* PL9, lds_int */
	};
};

&pwm {
	status = "okay";
};

/* Wi-Fi rail, off at boot; the Gen 1's RTL8189ES needs only DLDO1 */
&reg_dldo2 {
	regulator-always-on;
	regulator-min-microvolt = <3300000>;
	regulator-max-microvolt = <3300000>;
	regulator-name = "vcc-wifi-ext";
};

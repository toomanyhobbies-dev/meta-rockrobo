// SPDX-License-Identifier: (GPL-2.0+ OR MIT)
/* Xiaomi Mi Robot Vacuum (Roborock V1). Board details and test-boot policy: sun8i-r16-roborock.dtsi */

/dts-v1/;
#include "sun8i-r16-roborock.dtsi"

#include <dt-bindings/pwm/pwm.h>

/ {
	model = "Xiaomi Mi Robot Vacuum (Roborock V1)";
	compatible = "roborock,v1", "allwinner,sun8i-r16", "allwinner,sun8i-a33";

	/* lidar motor, [lds_para] and [pwm0_para] in the stock FEX; no mode lines */
	lds-motor {
		compatible = "roborock,lds-motor";
		pinctrl-names = "default";
		pinctrl-0 = <&pwm0_pin>;
		pwms = <&pwm 0 50000 PWM_POLARITY_INVERTED>;
		interrupts-extended = <&r_pio 0 9 IRQ_TYPE_EDGE_FALLING>;	/* PL9, lds_int */
	};
};

&pwm {
	status = "okay";
};

/* disabled under stock */
/delete-node/ &reg_dldo2;

/* eMMC: 4-bit SDR at 50 MHz; this board fails the 8-bit bus test, and 4-bit DDR52 reads byte-swapped */
&mmc2 {
	bus-width = <4>;
	rockrobo,no-ddr;
};
